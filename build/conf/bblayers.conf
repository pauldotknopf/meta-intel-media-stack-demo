## build/conf/bblayers.conf
```bitbake
# POKY_BBLAYERS_CONF_VERSION is increased each time build/conf/bblayers.conf
# changes incompatibly
POKY_BBLAYERS_CONF_VERSION = "2"

BBPATH = "${TOPDIR}"
BBFILES ?= ""
LAYERROOT := "${TOPDIR}/.."

BBLAYERS ?= " \
  ${LAYERROOT}/poky/meta \
  ${LAYERROOT}/poky/meta-poky \
  ${LAYERROOT}/poky/meta-yocto-bsp \
  "
BBLAYERS += " ${LAYERROOT}/meta-intel "
BBLAYERS += " ${LAYERROOT}/meta-gstreamer "
BBLAYERS += " ${LAYERROOT}/meta-intel-media-stack "
BBLAYERS += " ${LAYERROOT}/meta-magewell "
```
